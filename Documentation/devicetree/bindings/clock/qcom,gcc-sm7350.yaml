## Documentation/devicetree/bindings/clock/qcom,gcc-sm7350.yaml
```yaml
# SPDX-License-Identifier: (GPL-2.0-only OR BSD-2-Clause)
%YAML 1.2
---
$id: http://devicetree.org/schemas/clock/qcom,gcc-sm7350.yaml#
$schema: http://devicetree.org/meta-schemas/core.yaml#

title: Qualcomm Global Clock & Reset Controller on SM7350

maintainers:
  - Claude Agent <claude-agent@localhost>

description: |
  Qualcomm global clock control module provides the clocks, resets and power
  domains on SM7350.

  See also: include/dt-bindings/clock/qcom,gcc-sm7350.h

properties:
  compatible:
    const: qcom,gcc-sm7350

  clocks:
    items:
      - description: Board XO source
      - description: Sleep clock source
      - description: PCIE-0 pipe clock source
      - description: PCIE-1 pipe clock source
      - description: UFS phy rx symbol 0 clock source
      - description: UFS phy rx symbol 1 clock source
      - description: UFS phy tx symbol 0 clock source
      - description: USB30 phy wrapper pipe clock source

  clock-names:
    items:
      - const: bi_tcxo
      - const: sleep_clk
      - const: pcie_0_pipe_clk
      - const: pcie_1_pipe_clk
      - const: ufs_phy_rx_symbol_0_clk
      - const: ufs_phy_rx_symbol_1_clk
      - const: ufs_phy_tx_symbol_0_clk
      - const: usb3_phy_wrapper_gcc_usb30_pipe_clk

  power-domains:
    items:
      - description: CX domain

required:
  - compatible
  - clocks
  - clock-names
  - '#power-domain-cells'

allOf:
  - $ref: qcom,gcc.yaml#

unevaluatedProperties: false

examples:
  - |
    #include <dt-bindings/clock/qcom,rpmh.h>
    #include <dt-bindings/power/qcom-rpmpd.h>

    clock-controller@100000 {
      compatible = "qcom,gcc-sm7350";
      reg = <0x00100000 0x1f0000>;
      clocks = <&rpmhcc RPMH_CXO_CLK>,
               <&sleep_clk>,
               <&pcie_0_pipe_clk>, <&pcie_1_pipe_clk>,
               <&ufs_phy_rx_symbol_0_clk>, <&ufs_phy_rx_symbol_1_clk>,
               <&ufs_phy_tx_symbol_0_clk>,
               <&usb3_phy_wrapper_gcc_usb30_pipe_clk>;

      clock-names = "bi_tcxo", "sleep_clk", "pcie_0_pipe_clk",
                     "pcie_1_pipe_clk", "ufs_phy_rx_symbol_0_clk",
                     "ufs_phy_rx_symbol_1_clk", "ufs_phy_tx_symbol_0_clk",
                     "usb3_phy_wrapper_gcc_usb30_pipe_clk";
      power-domains = <&rpmhpd SM7350_CX>;
      #clock-cells = <1>;
      #reset-cells = <1>;
      #power-domain-cells = <1>;
    };
...
```

## Documentation/devicetree/bindings/interrupt-controller/qcom,pci-msi.yaml
```yaml
# SPDX-License-Identifier: (GPL-2.0-only OR BSD-2-Clause)
%YAML 1.2
---
$id: http://devicetree.org/schemas/interrupt-controller/qcom,pci-msi.yaml#
$schema: http://devicetree.org/meta-schemas/core.yaml#

title: Qualcomm PCIe MSI doorbell controller

maintainers:
  - Claude Agent <claude-agent@localhost>

description: |
  Some Qualcomm PCIe host controllers do not use the Synopsys DWC
  iMSI-RX window. Instead the PCIe host exposes a single MSI doorbell
  register; a write to that register with a GIC SPI number in its data
  payload raises the corresponding GIC SPI.

  The node is referenced from the PCIe host controller through the
  standard "msi-parent" property.

properties:
  compatible:
    const: qcom,pci-msi

  reg:
    maxItems: 1

  msi-controller: true

  '#msi-cells':
    const: 0

  interrupts:
    minItems: 1
    maxItems: 32

required:
  - compatible
  - reg
  - msi-controller
  - interrupts

additionalProperties: false

examples:
  - |
    #include <dt-bindings/interrupt-controller/arm-gic.h>

    msi-controller@17a10040 {
        compatible = "qcom,pci-msi";
        reg = <0x17a10040 0x1000>;
        msi-controller;
        #msi-cells = <0>;
        interrupt-parent = <&intc>;
        interrupts = <GIC_SPI 768 IRQ_TYPE_EDGE_RISING>,
                     <GIC_SPI 769 IRQ_TYPE_EDGE_RISING>;
    };
...
```

## Documentation/devicetree/bindings/pci/qcom,pcie-sm7350.yaml
```yaml
# SPDX-License-Identifier: (GPL-2.0-only OR BSD-2-Clause)
%YAML 1.2
---
$id: http://devicetree.org/schemas/pci/qcom,pcie-sm7350.yaml#
$schema: http://devicetree.org/meta-schemas/core.yaml#

title: Qualcomm SM7350 PCI Express Root Complex

maintainers:
  - Claude Agent <claude-agent@localhost>

description:
  The SM7350 PCIe root complex is based on the Synopsys DesignWare PCIe IP.
  Unlike the SM8350 variant it does not expose the TBU/DDRSS sideband clocks
  in the GCC block, so its clock list is shorter.

properties:
  compatible:
    const: qcom,pcie-sm7350

  reg:
    minItems: 5
    maxItems: 5

  reg-names:
    items:
      - const: parf
      - const: dbi
      - const: elbi
      - const: atu
      - const: config

  clocks:
    minItems: 7
    maxItems: 7

  clock-names:
    items:
      - const: aux
      - const: cfg
      - const: bus_master
      - const: bus_slave
      - const: slave_q2a
      - const: aggre1
      - const: aggre0

  interrupts:
    minItems: 9
    maxItems: 9

  interrupt-names:
    items:
      - const: msi0
      - const: msi1
      - const: msi2
      - const: msi3
      - const: msi4
      - const: msi5
      - const: msi6
      - const: msi7
      - const: global

  resets:
    maxItems: 1

  reset-names:
    items:
      - const: pci

  vdda-supply:
    description: PCIe controller analog supply

  vddpe-3v3-supply:
    description: 3.3V supply for the PCIe endpoint slot

required:
  - compatible
  - reg
  - reg-names
  - clocks
  - clock-names
  - power-domains
  - resets
  - reset-names

allOf:
  - $ref: qcom,pcie-common.yaml#

unevaluatedProperties: false
```

## Documentation/devicetree/bindings/power/supply/xiaomi,renoir-battery.yaml
```yaml
# SPDX-License-Identifier: (GPL-2.0-only OR BSD-2-Clause)
%YAML 1.2
---
$id: http://devicetree.org/schemas/power/supply/xiaomi,renoir-battery.yaml#
$schema: http://devicetree.org/meta-schemas/core.yaml#

title: Xiaomi renoir voltage-based battery monitor

maintainers:
  - Claude Agent <claude-agent@localhost>

description:
  A simple battery monitor for the Xiaomi renoir (SM7350).  It reads the
  PM8350B VBAT_SNS channel through the PMK8350 VADC and exposes a coarse
  voltage/OCV-based capacity through the power_supply class.  It is not a
  coulomb-counting fuel gauge.

properties:
  compatible:
    const: xiaomi,renoir-battery

  io-channels:
    maxItems: 1

  io-channel-names:
    const: voltage

required:
  - compatible
  - io-channels
  - io-channel-names

additionalProperties: false

examples:
  - |
    battery {
        compatible = "xiaomi,renoir-battery";
        io-channels = <&pmk8350_vadc 0x38f>;
        io-channel-names = "voltage";
    };
```
